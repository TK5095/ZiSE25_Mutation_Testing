## Kconfig
```kconfig
menu "Application Features"

config APP_LEDS
    bool "Enable LED warning animation"
    default y
    help
      If enabled, the LED warning animation thread will be built and run
      when the temperature threshold is exceeded.

config APP_BUZZER
    bool "Enable buzzer alarm"
    default y
    help
      If enabled, the buzzer alarm thread will be built and run
      when the temperature threshold is exceeded.

config APP_DISPLAY
    bool "Enable TM1637 7-segment display"
    default y
    help
      If enabled, the TM1637 display support will be built and initialized,
      and the current temperature will be shown on the display.

endmenu

source "Kconfig.zephyr"
```

## tests/test_temp_alert/testcase.yaml
```yaml
common:
  tags: [temp_alert, unit]
  filter: CONFIG_ZTEST
  harness: ztest
  integration_platforms: [native_sim]

tests:
  temp_alert.display:
    tags: [display, temp_alert, unit]
    platform_allow: [native_sim]
    harness: ztest

  temp_alert.buzzer:
    tags: [buzzer, temp_alert, unit]
    platform_allow: [native_sim]
    harness: ztest

  temp_alert.leds:
    tags: [leds, temp_alert, unit]
    platform_allow: [native_sim]
    harness: ztest
```

## west.yml
```yaml
manifest:
  remotes:
    - name: zephyrproject
      url-base: https://github.com/zephyrproject-rtos
  projects:
    - name: zephyr
      repo-path: zephyr
      remote: zephyrproject
      revision: v4.2.0
      import:
        path-prefix: deps
        name-allowlist:
          - cmsis
          - cmsis_6
          - cmsis-dsp
          - percepio
          - picolibc
          - segger
          - hal_nxp
          - hal_stm32
  self:
    path: temp_alert
    west-commands: west-commands.yml
```
