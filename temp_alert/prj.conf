## CMakeLists.txt
```
# SPDX-License-Identifier: Apache-2.0

cmake_minimum_required(VERSION 3.20.0)
find_package(Zephyr REQUIRED HINTS $ENV{ZEPHYR_BASE})
project(temp_alert)

target_include_directories(app PRIVATE inc)

target_sources(app PRIVATE src/main.c)
target_sources_ifdef(CONFIG_APP_DISPLAY app PRIVATE src/display.c)
target_sources_ifdef(CONFIG_APP_DISPLAY app PRIVATE src/tm1637.c)
target_sources_ifdef(CONFIG_APP_BUZZER app PRIVATE src/buzzer.c)
target_sources_ifdef(CONFIG_APP_LEDS app PRIVATE src/leds.c)
```

## prj.conf
```kconfig
CONFIG_LOG=y

CONFIG_I2C=y

CONFIG_SENSOR=y
CONFIG_SENSOR_ASYNC_API=y

CONFIG_APP_DISPLAY=y
CONFIG_APP_BUZZER=y
CONFIG_APP_LEDS=y
```

## src/main.c
```c
/*
 * SPDX-License-Identifier: Apache-2.0
 */

 #include <zephyr/kernel.h>
 #include <zephyr/device.h>
 #include <zephyr/devicetree.h>
 #include <zephyr/drivers/sensor.h>
 #include <zephyr/logging/log.h>
 #include <zephyr/sys/atomic.h>
 
 #include "display.h"
 #include "buzzer.h"
 #include "leds.h"
 
 #define TEMP_THRESHOLD_C     30   /* trip point in °C */
 #define TEMP_THREAD_STACK  1024
 #define THREAD_PRIORITY       5
 
 LOG_MODULE_REGISTER(temp_alarm, LOG_LEVEL_INF);
 
 /* The shared atomic flag: true when temp ≥ threshold */
 atomic_t alarm_flag = ATOMIC_INIT(0);
 
 /* BME280 sensor (first OKAY bosch,bme280 node) */
 static const struct device *const bme_dev =
	 DEVICE_DT_GET_ANY(bosch_bme280);
 
 static int sensor_init(void)
 {
	 if (!device_is_ready(bme_dev)) {
		 LOG_ERR("BME280 device %p not ready", bme_dev);
		 return -ENODEV;
	 }
	 LOG_INF("BME280 sensor %s ready", bme_dev->name);
	 return 0;
 }
 SYS_INIT(sensor_init, APPLICATION, CONFIG_APPLICATION_INIT_PRIORITY);
 
 /*--- temp thread: fetch & log & display & set alarm_flag ---*/
 static void temp_thread_fn(void *, void *, void *)
 {
	 struct sensor_value temp;
	 int ret;
 
	 while (1) {
		 ret = sensor_sample_fetch(bme_dev);
		 if (ret) {
			 LOG_ERR("sensor_sample_fetch failed: %d", ret);
			 k_sleep(K_SECONDS(1));
			 continue;
		 }
 
		 ret = sensor_channel_get(bme_dev,
								  SENSOR_CHAN_AMBIENT_TEMP,
								  &temp);
		 if (ret) {
			 LOG_ERR("sensor_channel_get failed: %d", ret);
			 k_sleep(K_SECONDS(1));
			 continue;
		 }
 
		 LOG_INF("Temp: %d.%06d °C",
				 temp.val1,
				 (temp.val2 < 0 ? -temp.val2 : temp.val2));
				 
 #if defined(CONFIG_APP_DISPLAY)
		 /* build segments XX.YY */
		 int deg = temp.val1;
		 __ASSERT(deg >= 0 && deg <= 999, "unexpected val1");
		 if (deg < 0) deg = 0;
		 if (deg > 99) deg = 99;
 
		 int hund = (temp.val2 >= 0 ? temp.val2 : -temp.val2) / 10000;
		 if (hund > 99) hund = 99;
 
		 uint8_t segs[4] = {
			 tm1637_segment_map[deg / 10],
			 tm1637_segment_map[deg % 10] | 0x80,
			 tm1637_segment_map[(hund / 10) % 10],
			 tm1637_segment_map[hund % 10],
		 };
		 display_write(segs);
#endif /* CONFIG_APP_DISPLAY */

		 /* threshold logic */
		 bool above = (temp.val1 > TEMP_THRESHOLD_C) ||
					  (temp.val1 == TEMP_THRESHOLD_C && temp.val2 >= 0);
 
		 if (above && !atomic_get(&alarm_flag)) {
			 atomic_set(&alarm_flag, 1);
			 LOG_WRN("Threshold reached");
		 } else if (!above && atomic_get(&alarm_flag)) {
			 atomic_set(&alarm_flag, 0);
			 LOG_INF("Back below threshold");
		 }
 
		 k_sleep(K_SECONDS(1));
	 }
 }
 
 K_THREAD_DEFINE(temp_thread, TEMP_THREAD_STACK,
				 temp_thread_fn, NULL, NULL, NULL,
				 THREAD_PRIORITY, 0, 0);
 
```

## inc/display.h
```c
#ifndef DISPLAY_H_
#define DISPLAY_H_

#include <stdint.h>

/* Initialize the TM1637 pins and clear the display */
int display_init(void);

/* Write exactly 4 segment bytes (bit7 = dot) */
int display_write(const uint8_t segs[4]);

/* Provided by tm1637.c */
extern const uint8_t tm1637_segment_map[16];

#endif /* DISPLAY_H_ */
```

## inc/leds.h
```c
#ifndef LEDS_H_
#define LEDS_H_

#include <zephyr/sys/atomic.h>

#define LED_THREAD_STACK    512
#define THREAD_PRIORITY       5

/* Initialize all LEDs */
int leds_init(void);

/* Thread that flashes LEDs when alarm_flag is set */
void leds_thread_fn(void *, void *, void *);

extern atomic_t alarm_flag;

#endif /* LEDS_H_ */
```

## inc/tm1637.h
```c
/* tm1637.h – public API for TM1637 4-digit 7-segment display
 * SPDX-License-Identifier: Apache-2.0
 */

 #ifndef TM1637_H_
 #define TM1637_H_
 
 #include <zephyr/drivers/gpio.h>
 #include <zephyr/sys/util.h>
 #include <stdint.h>
 
 /* brightness level 0..7 (0 = off, 7 = max) */
 #define TM1637_BRIGHTNESS_MAX 7
 
 /* device instance */
 struct tm1637 {
     struct gpio_dt_spec clk;
     struct gpio_dt_spec dio;
 };
 
 /* Initialize the two GPIO lines (CLK and DIO) */
 int tm1637_init(const struct tm1637 *dev);
 
 /* Set display brightness (0–7) */
 int tm1637_set_brightness(const struct tm1637 *dev, uint8_t brightness);
 
 /* Write exactly 4 raw segment bytes; bits 0–6 = segments A–G, bit 7 = dot */
 int tm1637_write_segments(const struct tm1637 *dev, const uint8_t segs[4]);
 
 /* Standard hex-digit → segment map (0–F) */
 extern const uint8_t tm1637_segment_map[16];
 
 #endif /* TM1637_H_ */
 
```

## src/buzzer.c
```c
/*
 * SPDX-License-Identifier: Apache-2.0
 */

 #include "buzzer.h"
 #include <zephyr/drivers/gpio.h>
 #include <zephyr/device.h>
 #include <zephyr/devicetree.h>
 #include <zephyr/kernel.h>
 #include <zephyr/logging/log.h>
 
 LOG_MODULE_DECLARE(temp_alarm);
 
 /* Buzzer GPIO */
 #define BUZZER_NODE DT_ALIAS(buzzer)
 static const struct gpio_dt_spec buzzer = GPIO_DT_SPEC_GET(BUZZER_NODE, gpios);
 
 #define TONE_FREQ_HZ 2000U
 
 static void play_tone(uint32_t freq_hz, uint32_t duration_ms)
 {
     uint32_t half_period_us = 500000U / freq_hz;
     uint32_t cycles = (freq_hz * duration_ms) / 1000U;
     for (uint32_t i = 0; i < cycles; i++) {
         gpio_pin_set_dt(&buzzer, 1);
         k_sleep(K_USEC(half_period_us));
         gpio_pin_set_dt(&buzzer, 0);
         k_sleep(K_USEC(half_period_us));
     }
 }
 
 void buzzer_fire_pattern(void)
 {
     for (int i = 0; i < 3; i++) {
         play_tone(TONE_FREQ_HZ, 500);
         k_sleep(K_MSEC(500));
     }
     k_sleep(K_MSEC(1500));
 }
 
 void buzzer_thread_fn(void *a, void *b, void *c)
 {
     ARG_UNUSED(a); ARG_UNUSED(b); ARG_UNUSED(c);
     while (1) {
         if (atomic_get(&alarm_flag)) {
             buzzer_fire_pattern();
         } else {
             k_sleep(K_MSEC(200));
         }
     }
 }
 
 static int buzzer_init(void)
 {
     int ret;
 
     if (!device_is_ready(buzzer.port)) {
         LOG_ERR("Buzzer GPIO %s not ready", buzzer.port->name);
         return -ENODEV;
     }
     ret = gpio_pin_configure_dt(&buzzer, GPIO_OUTPUT_INACTIVE);
     if (ret) {
         LOG_ERR("Failed to configure buzzer (%d)", ret);
         return ret;
     }
     LOG_INF("Buzzer initialized on %s", buzzer.port->name);
     return 0;
 }
 
 SYS_INIT(buzzer_init, APPLICATION, CONFIG_APPLICATION_INIT_PRIORITY);
 
 K_THREAD_DEFINE(buzzer_thread, BUZZER_THREAD_STACK,
                 buzzer_thread_fn, NULL, NULL, NULL,
                 THREAD_PRIORITY, 0, 0);
 
```

## src/display.c
```c
/*
 * SPDX-License-Identifier: Apache-2.0
 */

 #include "display.h"
 #include "tm1637.h"
 
 #include <zephyr/device.h>
 #include <zephyr/devicetree.h>
 #include <zephyr/drivers/gpio.h>
 #include <zephyr/logging/log.h>
 #include <zephyr/kernel.h>
 
 LOG_MODULE_DECLARE(temp_alarm);
 
 /* Bring in the same DT-spec you use in main.c */
 #define CLK_NODE DT_NODELABEL(tm1637_clk)
 #define DIO_NODE DT_NODELABEL(tm1637_din)
 
 static const struct tm1637 disp = {
     .clk = GPIO_DT_SPEC_GET(CLK_NODE, gpios),
     .dio = GPIO_DT_SPEC_GET(DIO_NODE, gpios),
 };
 
 int display_init(void)
 {
     int err;
 
     /* tm1637_init() will configure both pins for us */
     err = tm1637_init(&disp);
     if (err) {
         LOG_ERR("TM1637 init failed: %d", err);
         return err;
     }
 
     /* clear display (all zeros) */
     {
         uint8_t zeros[4] = {0, 0, 0, 0};
         tm1637_write_segments(&disp, zeros);
     }
 
     /* set a reasonable brightness (0–7) */
     tm1637_set_brightness(&disp, TM1637_BRIGHTNESS_MAX / 2);
 
     LOG_INF("TM1637 display ready");
     return 0;
 }
 
 int display_write(const uint8_t segs[4])
 {
     return tm1637_write_segments(&disp, segs);
 }
 
 /* run at APPLICATION init level */
 SYS_INIT(display_init, APPLICATION, CONFIG_APPLICATION_INIT_PRIORITY);
 
```
